## conf/layer.conf
```bitbake
# Configuration details for the layer
BBPATH .= ":${LAYERDIR}"
BBFILES += "${LAYERDIR}/recipes-*/*/*.bb \
            ${LAYERDIR}/recipes-*/*/*.bbappend"

BBFILE_COLLECTIONS += "mylayer"
BBFILE_PATTERN_mylayer:= "^${LAYERDIR}"
BBFILE_PRIORITY_mylayer = "11"
LAYERSERIES_COMPAT_mylayer = "kirkstone"
```
